// ============================================================================

// oled_display.h — e-Brush ESP32-S3 机载 0.96" OLED (SSD1306 128x64, I2C) 显示层

//                    从 oled_monitor.ino 提取, 接入 main.cpp 的 Runtime rt 真实数据。

//

// 使用: 在 main.cpp 的 namespace { ... } 内部 (rt 定义之后) #include "oled_display.h";

//       setup() 里调用 oled_init();  loop() 里调用 oled_uploop();

//   OLED 走专用第二 I2C 总线 (Wire1 / I2C1), 与传感器总线 (Wire / I2C0) 物理隔离。

//   按钮: 外接按钮, 信号脚 GPIO5, 另一端接 GND (上拉输入, 按下=低电平)。

// ============================================================================

// 1. 硬件配置

// ★ 接线前务必按板子原理图核对这两个 GPIO 是否空闲。
// OLED 使用 *专用第二 I2C 总线* — Wire1 = ESP32-S3 的 I2C1 控制器, 与
// 6.667kHz 采样的传感器总线 (Wire = I2C0) 物理隔离, 避免显示刷新挤占
// 传感器采样时序导致 sched_overrun (详见 DESIGN_OLED_I2C.md §2)。
// 2026-09-23 按板子实际接线确认: SDA=GPIO15, SCL=GPIO16。
#define OLED_SDA 15
#define OLED_SCL 16
#define OLED_CLK_HZ 400000UL

// 若必须与传感器共享总线 (不推荐): 把下面 OLED_WIRE / OLED_BUS_BEGIN 两行
// 换成 Wire 并把引脚改成固件现有 I2C0 的引脚, e.g.
//     #define OLED_WIRE Wire
//     #define OLED_BUS_BEGIN() Wire.begin(48, 47, OLED_CLK_HZ)
#define OLED_WIRE Wire1
#define OLED_BUS_BEGIN() OLED_WIRE.begin(OLED_SDA, OLED_SCL, OLED_CLK_HZ)

// 显示刷新节流: 霍尔/IMU 原始采样率 6.667kHz, 人眼可读 20Hz 足够
#define OLED_REFRESH_MS 50

// 页面切换时间 (4 行显示放不下全部数据, 双页轮换)
#define OLED_PAGE_SWITCH_MS 2000

// 传感器工程常量 —— 与 host/brush_serial.py 保持同口径, OLED 读数可直接
// 与 TouchDesigner CHOP 数值对照:
//   accel ±4g 配置: 0.122 mg/LSB   -> g = raw * 0.000122
//   gyro  ±1000dps: 35.0 mdps/LSB  -> dps = raw * 0.035
//   霍尔变体: 1 -> 820 LSB/mT, 2 -> 250 LSB/mT; 0 = 未知, 显示原始码
#define ACCEL_MG_PER_LSB 0.122f
#define GYRO_MDPS_PER_LSB 35.0f
#define HALL_LSB_PER_MT 0.0f       // 0 = 显示原始码; 填入 820.0f / 250.0f 显示 mT

// ★ 按钮 (页面切换): 外接按钮, 信号脚 GPIO5, 另一端接 GND。
//   按下时 GPIO5 被拉低 → 上拉输入 + 按下=低电平。
//   GPIO5 在 brush_config.h 中未被占用 (HALL 8/9/4、SPI 12/11/13/10)。
#define BOOT_BUTTON_PIN 5
#define BOOT_BUTTON_DEBOUNCE_MS 50
// 开机稳定期: 上电瞬间 GPIO5 电平未稳定, 短暂稳定期内忽略按钮。
#define BOOT_STABLE_MS 500

// 2. 传感器数据快照 (★ 必须放在第一个函数定义之前 ★)
//    PlatformIO/Arduino 的 .ino 预处理器会把所有函数原型插到文件内首个函数
//    定义之前; 若此处自定义类型声明晚于函数, 自动生成的原型就会引用到
//    尚未声明的类型而编译失败。因此本 typedef 必须位于文件前部。
typedef struct {
  int32_t hall_x, hall_y, hall_z;   // TMAG5273 原始码 (或经变体系数换算)
  int32_t hall_temp_raw;
  int32_t accel[3];                 // 原始码
  int32_t gyro[3];                  // 原始码
  int32_t quat[4];                  // q0..q3 (Mahony 输出, 归一化后取整放大)
  uint16_t device_status;           // 契约 STATUS_BITS: bit0 hall_present, ...
  uint8_t  drop_flags;              // 契约 DROP_BITS: bit0 sched_overrun, ...
  bool     hall_ok, imu_ok, pose_ok;
} sensor_snapshot_t;

static sensor_snapshot_t g_snap;

// 2b. 开机黄宾虹像素头像 (128x64, 8 页纵向小端模式, 与 oled_gram 同布局)
//     源文件: D:\BaiduNetdiskDownload\HuangBinhong_OLED_Boot_Animation.ino
//     两张 1024 字节全屏帧, 按 [x][page] 逐列式写入 GRAM。
//     PROGMEM: ESP32 Arduino 把数组放进 flash (避免 1 KB 挤占 19 KB RAM)。

#define OLED_W 128
#define OLED_H 64
#define OLED_CMD 0
#define OLED_DATA 1

// 2b. 开机黄宾虹像素头像 (128x64, 8 页纵向小端模式, 与 oled_gram 同布局)
//     源文件: D:\BaiduNetdiskDownload\HuangBinhong_OLED_Boot_Animation.ino
//     两张 1024 字节全屏帧, 按 [x][page] 逐列式写入 GRAM。
//     ESP32 Arduino 把数组放进 flash (避免 2 KB 挤占 19 KB RAM)。
static const uint8_t HUANG_1[1024]={
  0x00,0x00,0x00,0x00,0x00,0x00,0x00,0x00,0x00,0x00,0x00,0x00,0x00,0x00,0x00,0x00,
  0x00,0x00,0x00,0x00,0x00,0x00,0x00,0x00,0x00,0x00,0x00,0x00,0x00,0x00,0x00,0x00,
  0x00,0x00,0x00,0x00,0x00,0x00,0x00,0x00,0x00,0x00,0x00,0x00,0x00,0x00,0x00,0x00,
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  0x00,0x00,0x00,0x00,0x00,0x00,0x00,0x00,0x00,0x00,0x00,0x00,0x00,0x00,0x00,0x00,
};

static const uint8_t HUANG_2[1024]={
  0x00,0x00,0x00,0x00,0x00,0x00,0x00,0x00,0x00,0x00,0x00,0x00,0x00,0x00,0x00,0x00,
  0x00,0x00,0x00,0x00,0x00,0x00,0x00,0x00,0x00,0x00,0x00,0x00,0x00,0x00,0x00,0x00,
  0x00,0x00,0x00,0x00,0x00,0x00,0x00,0x00,0x00,0x00,0x00,0x00,0x00,0x00,0x00,0x00,
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  0x00,0x00,0x00,0x00,0x00,0x00,0x00,0x00,0x00,0x00,0x00,0x00,0x00,0x00,0x00,0x00,
};
static uint8_t oled_addr = 0x00;         // 探测后写入
static bool oled_present = false;
// ★ GRAM 布局: [page][x] 页优先 —— oled_refresh() 用 &oled_gram[i][0]
//   取地址连续发 128 字节, SSD1306 页 i 模式下这 128 字节 = 列0..127。
//   (曾误声明为 [OLED_W][8] 列优先, &oled_gram[0][i] 往后 128 字节会跨页
//    拼接, 导致整屏画面错位 = 花屏。)
static uint8_t oled_gram[8][OLED_W];     // 页寻址: [page][x]

static void oled_wr_byte(uint8_t dat, uint8_t mode) {
  OLED_WIRE.beginTransmission(oled_addr);
  OLED_WIRE.write(mode ? 0x40 : 0x00);   // 0x00=命令流, 0x40=数据流
  OLED_WIRE.write(dat);
  OLED_WIRE.endTransmission();
}

// 数据流分块写: ESP32 Arduino 默认 I2C 缓冲 ~128B, 页刷新(128B)需分块
static void oled_wr_data(const uint8_t* p, size_t n) {
  const size_t CHUNK = 32;
  size_t off = 0;
  while (off < n) {
    size_t k = (CHUNK < (n - off)) ? CHUNK : (n - off);
    OLED_WIRE.beginTransmission(oled_addr);
    OLED_WIRE.write(0x40);
    OLED_WIRE.write(p + off, k);
    OLED_WIRE.endTransmission();
    off += k;
  }
}

static void oled_clear(void) {
  for (uint8_t p = 0; p < 8; p++)
    for (uint8_t x = 0; x < OLED_W; x++)
      oled_gram[p][x] = 0;
}

// 全屏刷新: 8 页 x 128 列 (与例程 OLED_Refresh 相同, 页寻址模式)
// ★ &oled_gram[i][0] 是页 i 的 128 列连续内存 —— 页优先布局才能这样取。
static void oled_refresh(void) {
  for (uint8_t i = 0; i < 8; i++) {
    oled_wr_byte(0xB0 + i, OLED_CMD);
    oled_wr_byte(0x00, OLED_CMD);
    oled_wr_byte(0x10, OLED_CMD);
    oled_wr_data(&oled_gram[i][0], OLED_W);
  }
}

// forward decl: probe_oled_addr 定义在后面 (提取自原 setup() 段)
static uint8_t probe_oled_addr(void);

// 初始化序列: 中景园例程命令原样 (0x20/0x02 页寻址, charge pump 0x8D/0x14)
// ★ 必须自包含探测逻辑: 原 .ino 的 setup() 里是
//     oled_addr = probe_oled_addr();
//     oled_present = (oled_addr != 0x00);
//     if (oled_present) { oled_init(); ... }
//   提取为头文件删掉 setup() 后, 探测必须并进 oled_init(), 否则 oled_present
//   恒为 false, oled_uploop() 里 if (oled_present) 永不渲染 → 全黑。
//     oled_init() 返回 true 表示成功初始化, false 表示 I2C 探测无应答。
static bool oled_init(void) {
  OLED_BUS_BEGIN();          // ★ 必须先启动 Wire1 (I2C1)
  oled_addr = probe_oled_addr();
  oled_present = (oled_addr != 0x00);
  if (!oled_present) return false;
  static const uint8_t init_cmds[] = {
    0xAE,                 // display off
    0x00, 0x10,           // column addr
    0x40,                 // start line
    0x81, 0xCF,           // contrast
    0xA1, 0xC8,           // segment remap / com scan
    0xA6,                 // normal display
    0xA8, 0x3F,           // multiplex 1/64
    0xD3, 0x00,           // display offset
    0xD5, 0x80,           // clock div
    0xD9, 0xF1,           // pre-charge
    0xDA, 0x12,           // com pins
    0xDB, 0x40,           // vcomh
    0x20, 0x02,           // page addressing mode
    0x8D, 0x14,           // charge pump on
    0xA4, 0xA6,           // resume / normal
    0xAF                  // display on
  };
  for (size_t i = 0; i < sizeof(init_cmds); i++)
    oled_wr_byte(init_cmds[i], OLED_CMD);
  oled_clear();
  oled_refresh();
  return true;
}

// 画点 / 清点 (页寻址逐列式, 与例程一致)
static void oled_draw_point(uint8_t x, uint8_t y) {
  if (x >= OLED_W || y >= OLED_H) return;
  oled_gram[y / 8][x] |= (1 << (y % 8));
}
static void oled_clear_point(uint8_t x, uint8_t y) {
  if (x >= OLED_W || y >= OLED_H) return;
  oled_gram[y / 8][x] &= ~(1 << (y % 8));
}

// 4. 文本 (复用中景园 font.h: asc2_1206 / asc2_1608 / asc2_2412)
static void oled_show_char(uint8_t x, uint8_t y, char chr, uint8_t size1) {
  uint8_t size2 = (size1 / 8 + ((size1 % 8) ? 1 : 0)) * (size1 / 2);
  uint8_t chr1 = (uint8_t)(chr - ' ');
  uint8_t y0 = y;
  for (uint8_t i = 0; i < size2; i++) {
    uint8_t temp;
    if (size1 == 12)      temp = pgm_read_byte(&asc2_1206[chr1][i]);
    else if (size1 == 16) temp = pgm_read_byte(&asc2_1608[chr1][i]);
    else if (size1 == 24) temp = pgm_read_byte(&asc2_2412[chr1][i]);
    else return;
    for (uint8_t m = 0; m < 8; m++) {
      if (temp & 0x80) oled_draw_point(x, y);
      else             oled_clear_point(x, y);
      temp <<= 1;
      y++;
      if ((y - y0) == size1) { y = y0; x++; break; }
    }
  }
}

static void oled_show_string(uint8_t x, uint8_t y, const char* s, uint8_t size1) {
  while (*s >= ' ' && *s <= '~') {
    oled_show_char(x, y, *s, size1);
    x += size1 / 2;
    if (x > OLED_W - size1 / 2) { x = 0; y += size1; }
    s++;
  }
}

static void read_sensor_snapshot() {
  if (rt.hall_ok) {
    g_snap.hall_x        = rt.hall_sample.x_raw;
    g_snap.hall_y        = rt.hall_sample.y_raw;
    g_snap.hall_z        = rt.hall_sample.z_raw;
    g_snap.hall_temp_raw = rt.hall_sample.temp_raw;
    g_snap.device_status = rt.hall_sample.device_status;
  } else {
    g_snap.hall_x = g_snap.hall_y = g_snap.hall_z = 0;
    g_snap.hall_temp_raw = 0;
    g_snap.device_status = 0;
  }
  if (rt.imu_ok) {
    g_snap.accel[0] = rt.imu_sample.ax_raw;
    g_snap.accel[1] = rt.imu_sample.ay_raw;
    g_snap.accel[2] = rt.imu_sample.az_raw;
    g_snap.gyro[0]  = rt.imu_sample.gx_raw;
    g_snap.gyro[1]  = rt.imu_sample.gy_raw;
    g_snap.gyro[2]  = rt.imu_sample.gz_raw;
  } else {
    g_snap.accel[0] = g_snap.accel[1] = g_snap.accel[2] = 0;
    g_snap.gyro[0]  = g_snap.gyro[1]  = g_snap.gyro[2]  = 0;
  }
  g_snap.quat[0] = (int32_t)(rt.q_w * 1000.0f);
  g_snap.quat[1] = (int32_t)(rt.q_x * 1000.0f);
  g_snap.quat[2] = (int32_t)(rt.q_y * 1000.0f);
  g_snap.quat[3] = (int32_t)(rt.q_z * 1000.0f);
  g_snap.hall_ok   = rt.hall_ok;
  g_snap.imu_ok    = rt.imu_ok;
  g_snap.pose_ok   = true;
  g_snap.drop_flags = 0;
}

// 5a. 开机画面 (黄宾虹头像): 把 1024 字节 BMP 帧拷进 GRAM
//     BMP 源布局 [x][page] (列优先, page=y/8, 位=y%8 小端), 与 oled_gram
//     的 [page][x] 互转: oled_gram[p][x] = bmp[x + p*128]。
static void oled_show_bmp(const uint8_t* bmp) {
  for (uint8_t p = 0; p < 8; p++)
    for (uint8_t x = 0; x < OLED_W; x++)
      oled_gram[p][x] = pgm_read_byte(&bmp[x + p * OLED_W]);
}

// 开机循环: HUANG_1 -> HUANG_2 -> HUANG_1 -> HUANG_2 -> HUANG_1
// 时序与 HuangBinhong_OLED_Boot_Animation.ino 原始 loop() 完全一致。
// ★ 每次调用都完整重画当前帧 (clear+draw+refresh 自管), 不提前 return ——
//   否则未到切换时刻时不重画, 而调用方每 50ms 先 clear 后 refresh, 屏幕会
//   在"清空后不画"的间隙里全黑, 图案只在切换瞬间闪一帧 = 黑屏空帧。
static void render_boot(void) {
  static const uint32_t seq_ms[] = { 1200, 700, 300, 2500, 800 };
  static const uint8_t* frame[] = { HUANG_1, HUANG_2, HUANG_1, HUANG_2, HUANG_1 };
  static uint8_t step = 0;
  static uint32_t next_ms = 0;

  uint32_t now = millis();
  if (now >= next_ms) {
    next_ms = now + seq_ms[step];
    step = (step + 1) % (sizeof(seq_ms) / sizeof(seq_ms[0]));
  }

  oled_clear();
  oled_show_bmp(frame[step]);
  oled_refresh();
}

// 5b. 按钮: 上拉输入, 按下=低电平; 去抖后翻转页面
static bool button_read(void) {
  return digitalRead(BOOT_BUTTON_PIN) == LOW;
}

static bool button_was_pressed(void) {
  static uint32_t last_debounce = 0;
  static bool last_state = false;
  static uint32_t low_since = 0;
  bool now = button_read();
  // ★ 注意: main.cpp 的 UART (Serial) 是 921600 二进制协议通道, 不能混入
  //   文本日志。OLED 的按钮/页面诊断输出已全部移除 (原 .ino 独立固件才可打印)。
  uint32_t m = millis();
  // ★ 有效按下 = 低电平持续 >= BOOT_BUTTON_DEBOUNCE_MS (50ms)。
  //   DTR/RTS 的抖动脉冲 <50ms 会被过滤; 真实按钮按下至少 50ms。
  if (now) {
    if (low_since == 0) low_since = m;
    if (m - low_since >= BOOT_BUTTON_DEBOUNCE_MS) {
      if (!last_state) {
        last_state = true;
        last_debounce = m;
        return true;
      }
    }
  } else {
    low_since = 0;
    if (last_state) last_state = false;
  }
  return false;
}

// 5c. 显示布局 (8x16 字体: 每行 16 字符 x 4 行; 双页轮换)
//     自包含: 内部完成 clear + 绘制 + 上屏, 调用者只管节流。
static void render_page(uint8_t page) {
  char line[17];
  oled_clear();

  if (page == 0) {
    // 页0: 标题 / 霍尔 / 加速度 / 陀螺
    oled_show_string(0, 0, "e-Brush v1.1.0 ", 16);

    if (HALL_LSB_PER_MT > 0.0f) {
      // 霍尔 mT
      snprintf(line, sizeof line, "H%+5.1f%+5.1f%+5.1f",
               g_snap.hall_x / HALL_LSB_PER_MT,
               g_snap.hall_y / HALL_LSB_PER_MT,
               g_snap.hall_z / HALL_LSB_PER_MT);
    } else {
      snprintf(line, sizeof line, "H%+5d%+5d%+5d",
               g_snap.hall_x, g_snap.hall_y, g_snap.hall_z);
    }
    oled_show_string(0, 16, line, 16);

    snprintf(line, sizeof line, "A%+5.2f%+5.2f%+5.2f",
             g_snap.accel[0] * ACCEL_MG_PER_LSB * 1e-3f,
             g_snap.accel[1] * ACCEL_MG_PER_LSB * 1e-3f,
             g_snap.accel[2] * ACCEL_MG_PER_LSB * 1e-3f);
    oled_show_string(0, 32, line, 16);

    snprintf(line, sizeof line, "G%+5.1f%+5.1f%+5.1f",
             g_snap.gyro[0] * GYRO_MDPS_PER_LSB * 1e-3f,
             g_snap.gyro[1] * GYRO_MDPS_PER_LSB * 1e-3f,
             g_snap.gyro[2] * GYRO_MDPS_PER_LSB * 1e-3f);
    oled_show_string(0, 48, line, 16);
  } else {
    // 页1: 标题 / 四元数 / 温度+drop flags / 运行时间+空闲堆
    oled_show_string(0, 0, "e-Brush v1.1.0 ", 16);

    snprintf(line, sizeof line, "Q%+5.2f%+5.2f%+5.2f",
             g_snap.quat[0] * 1e-3f,
             g_snap.quat[1] * 1e-3f,
             g_snap.quat[2] * 1e-3f);
    oled_show_string(0, 16, line, 16);

    snprintf(line, sizeof line, "T%+5.1fC F%02X",
             25.0f + (g_snap.hall_temp_raw - 17508.0f) / 58.0f,
             g_snap.drop_flags);
    oled_show_string(0, 32, line, 16);

    snprintf(line, sizeof line, "UP%5ds HP%4dK",
             (int)(millis() / 1000), (int)(ESP.getFreeHeap() / 1024));
    oled_show_string(0, 48, line, 16);
  }
  oled_refresh();   // 自包含上屏
}

// 6. setup / loop
static uint32_t last_refresh = 0;
// ★ 三态页面: 0=开机页(黄宾虹动画) / 1=数据页0(霍尔+加速度+陀螺)
//              / 2=数据页1(四元数+温度+运行信息)。按钮循环切换, 无自动轮换。
static uint8_t disp_state = 0;

// 开机自动探测 I2C 地址: SSD1306 默认 0x3C (0x3C<<1 = 0x78, 即例程的 0x78),
// 部分模块可通过背面跳线切到 0x3D。
static uint8_t probe_oled_addr(void) {
  static const uint8_t candidates[] = { 0x3C, 0x3D };
  for (size_t i = 0; i < sizeof(candidates); i++) {
    OLED_WIRE.beginTransmission(candidates[i]);
    if (OLED_WIRE.endTransmission() == 0) return candidates[i];
  }
  return 0x00;   // 未找到
}


void oled_uploop(void) {   // 供固件主循环调用的显示任务 (见 README 接入步骤)
  // ★ 按钮: 三态循环切换 —— 开机页 -> 数据页0 -> 数据页1 -> 开机页 -> ...
  uint32_t now = millis();
  if (now >= BOOT_STABLE_MS && button_was_pressed()) {
    disp_state = (disp_state + 1) % 3;
    last_refresh = 0;   // 立即重绘, 不等 50ms 节流
    // 诊断说明: page 切换不再打日志 (main.cpp 串口是二进制协议通道)
  }

  read_sensor_snapshot();   // 从 Runtime rt 读取真实传感器数据

  // render_*() 已自包含 clear+draw+refresh, 这里只管节流
  if (now - last_refresh >= OLED_REFRESH_MS) {
    last_refresh = now;
    if (oled_present) {
      if (disp_state == 0) {
        render_boot();        // 开机页: 黄宾虹头像动画
      } else {
        render_page(disp_state - 1);  // 数据页0/1: 霍尔 / IMU / 四元数
      }
    }
  }
}

